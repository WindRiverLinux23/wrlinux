## wrlinux-distro/conf/distro/wrlinux-installer.conf
```bitbake
#@TYPE: Distro
#@NAME: Wind River Linux Installer
#@DESCRIPTION: Wind River Linux (Anaconda-based Target Installer)

require wrlinux.conf
require conf/distro/anaconda.conf
include include/wrlinux-installer-recipelists.inc

WRLINUX_VARIANT = " Installer"
DISTRO = "anaconda"

IMAGE_FSTYPES:pn-wrlinux-image-installer:append = " live"

CUSTOMIZE_LOGOS ?= "windriver-logos"

# clear WRTEMPLATE for installer image
WRTEMPLATE:anaconda = ""
```

## wrlinux-ovp/conf/distro/include/wrlinux-ovp-recipelists.conf
```bitbake
#
# Copyright (C) 2017 Wind River Systems, Inc.
#
# Explicitly allow these recipes in wrlinux
#

# Recipes allowed the whole wrlinux-distro layer
RECIPE_LIST_LAYERS:remove = "wrlinux-ovp"

# Recipes allowed for meta-cloud-services
WRL_RECIPES:cloud-services-layer:append = " \
    celt051 \
    librdmacm \
"

WRL_RECIPES:networking-layer:append = " \
    spice \
    spice-protocol \
"

# Recipes allowed for meta-openembedded/meta-oe
WRL_RECIPES:openembedded-layer:append = " \
    byacc \
    gd \
    leveldb \
    rocksdb \
    snappy \
"

# Recipes allowed for meta-realtime
WRL_RECIPES:realtime:append = " \
    schedtool-dl \
"

# Recipes allowed for meta-virtualization
WRL_RECIPES:virtualization-layer:append = " \
    ceph \
    diod \
    libibverbs \
    libvmi \
    oath \
"
```

## wrlinux-ovp/conf/distro/wrlinux-ovp.conf
```bitbake
# Set this before including wrlinux.conf just in case that
# also tries to set it.
#

#@TYPE: Distro
#@NAME: Wind River Linux OVP
#@DESCRIPTION: Wind River Linux (Open Virtualization)

PREFERRED_PROVIDER_virtual/kernel = "linux-yocto-rt"

require conf/distro/wrlinux.conf
require conf/distro/include/wrlinux-ovp-recipelists.conf

# Note that layer.conf will only add items to BBFILES for
# the wrlinux-ovp distro (this one).
#
WRLINUX_VARIANT = " OVP"

# OVP distro should not be built for non-x86 archs
INHERIT += "compatible-archs"

# Set preferred providers
PREFERRED_PROVIDER_virtual/libibverbs ?= "libibverbs"

DISTRO_FEATURES:append = " virtualization kvm"
NON_MULTILIB_RECIPES:append = " ceph docker"

# The latest dpdk version compatible with the latest openvswitch version
PREFERRED_VERSION_dpdk ?= "21.11.%"
PREFERRED_VERSION_dpdk-module ?= "21.11.%"
```
